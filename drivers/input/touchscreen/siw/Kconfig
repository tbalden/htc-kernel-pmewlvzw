## drivers/input/touchscreen/siw/Kconfig
```kconfig
menu "SiW Touch Support"

config TOUCHSCREEN_SIW
	bool "Silicon Works Touch Driver Core"
	depends on SPI_MASTER && I2C
	default n
	help
	  Say Y here if you have a touchscreen interface using
	  the Silicon Works touch device.

config TOUCHSCREEN_SIW_LG4894
	bool "Silicon Works Touch Driver for LG4894"
	depends on TOUCHSCREEN_SIW
	default n
	help
	  If your device is LG4894, say Y

config TOUCHSCREEN_SIW_LG4895
	bool "Silicon Works Touch Driver for LG4895"
	depends on TOUCHSCREEN_SIW
	default n
	help
	  If your device is LG4895, say Y

config TOUCHSCREEN_SIW_LG4946
	bool "Silicon Works Touch Driver for LG4946"
	depends on TOUCHSCREEN_SIW
	default n
	help
	  If your device is LG4946, say Y

config TOUCHSCREEN_SIW_SW1828
	bool "Silicon Works Touch Driver for SW1828"
	depends on TOUCHSCREEN_SIW
	default n
	help
	  If your device is SW1828, say Y

config TOUCHSCREEN_SIW_SW49407
	bool "Silicon Works Touch Driver for SW49407"
	depends on TOUCHSCREEN_SIW
	default n
	help
	  If your device is SW49407, say Y

config TOUCHSCREEN_HTC_ATTR
	bool "HTC Standard arrtibute files"
	depends on TOUCHSCREEN_SIW
	default y
	help
	  If HTC attribute files are not used, say N

config TOUCHSCREEN_HTC_DEBUG
	bool "HTC debug & misc"
	depends on TOUCHSCREEN_SIW
	default n
	help
	  If HTC debug & misc function are not used, say N

config TOUCHSCREEN_HTC_DEBUG_SPI
	bool "HTC SPI debug & misc"
	depends on TOUCHSCREEN_SIW
	default n
	help
	  If HTC SPI debug & misc function are not used, say N

source "drivers/input/touchscreen/siw/mon/Kconfig"

endmenu
```

## drivers/staging/nanohub/Kconfig
```kconfig
config NANOHUB
	tristate "Nanohub"
	default N
	help
	  Enable support for the nanohub sensorhub driver.

	  This driver supports the android nanohub sensorhub.

	  If in doubt, say N here.

if NANOHUB

config NANOHUB_SPI
	bool "Nanohub SPI"
	default Y
	help
	  Enable nanohub SPI support.

	  Either this or NANOHUB_I2C should be selected.

	  If in doubt, say Y here.

config NANOHUB_I2C
	bool "Nanohub I2C"
	default N
	help
	  Enable nanohub I2C support.

	  Either this or NANOHUB_SPI should be selected.

	  If in doubt, say N here.

config NANOHUB_CONTEXTHUB_HAL
	bool "Nanohub ContextHub HAL"
	default N
	help
	  Enable contextHub HAL support.

config NANOHUB_TP_SWITCH
	bool "TP switch pin status synchronization"
	default n
	help
	  TP switch pin status synchronization

config NANOHUB_SECOND_DISP
	bool "Second Disp"
	default n
	depends on NANOHUB_TP_SWITCH
	help
	  Second Disp

config NANOHUB_HTC_LOG
	bool "Trigger dump htc log"
	default n
	help
	  Trigger dump htc log

endif # NANOHUB
```

## drivers/usb/anx7688/Kconfig
```kconfig
config ANALOGIX_7688
	tristate "Analogix Type-C interface support"
	default n
	help
        	Analogix type-c interface is a  chip support USB PD protocol device

       
```

## drivers/usb/cypd4225/Kconfig
```kconfig
config CYPD4225
	tristate "Cypress CYPD4225 driver"
	default n
	help
        	Cypress CYPD4225 driver

       
```
