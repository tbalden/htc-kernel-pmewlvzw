qcom,oce-unknown-batterydata {
	/* #2644504_HTC_B2PZF100atl_3000mAh_averaged_MasterSlave_Nov30th2016 */
	qcom,max-voltage-uv = <4400000>;
	qcom,v-cutoff-uv = <3250000>;
	qcom,nom-batt-capacity-mah = <3000>;
	qcom,batt-id-kohm = <40>;
	qcom,battery-beta = <4360>;
	qcom,battery-type = "oce_unknown";
	qcom,chg-rslow-comp-c1 = <3297024>;
	qcom,chg-rslow-comp-c2 = <4672918>;
	qcom,chg-rs-to-rslow = <1017854>;
	qcom,chg-rslow-comp-thr = <0xA5>;
	qcom,checksum = <0xEC7C>;
	qcom,gui-version = "PMI8996GUI - 1.0.1.4";
	htc,batt_id = <254>;
	htc,id_raw_min = <27501>;
	htc,id_raw_max = <99999>;
	qcom,fg-profile-data = [
		EB 83 13 7D
		25 81 64 77
		59 83 15 65
		6D 82 34 8D
		0A 82 D7 9A
		1B BE 80 CB
		5B 0E 2A 83
		56 69 AE 6A
		5C 49 3D 83
		74 78 A2 84
		0B 80 B7 82
		4E 91 09 AF
		5E BA 7D 13
		A2 0B 15 5A
		14 70 52 F8
		62 3D 26 45
		77 41 00 00
		27 46 3A 38
		AF 41 00 00
		00 00 00 00
		00 00 00 00
		5D 70 33 6B
		E0 6B 36 8A
		4D 75 8C 68
		22 6D 07 79
		F0 6F 0D 61
		E4 54 47 A8
		1E F7 62 CC
		64 A0 71 0C
		28 00 FF 36
		F0 11 30 03
		00 00 00 0C
	];
};
